## firmware/main/Kconfig.projbuild
```kconfig
menu "Xiaozhi Configuration"

    choice WIFI_PROVISIONING_MODE
        prompt "WiFi Provisioning Mode"
        default USE_HOTSPOT_WIFI_PROVISIONING
        help
            Select the WiFi provisioning mechanism.

        config USE_HOTSPOT_WIFI_PROVISIONING
            bool "SoftAP Hotspot Portal Mode"
        config USE_ESP_BLUFI_WIFI_PROVISIONING
            bool "BLE BluFi Mode"
    endchoice

    config USE_DEVICE_AEC
        bool "Enable Device-Side Echo Cancellation (AEC)"
        default n
        help
            Enable AEC on the ESP32 hardware/software before sending audio.

    config USE_SERVER_AEC
        bool "Enable Server-Side Echo Cancellation (AEC)"
        default n
        help
            Instruct the server to perform echo cancellation.

    config CUSTOM_WAKE_WORD
        bool "Enable Custom Wake Word"
        default n
        help
            Use a custom offline model or logic for wake word detection.

    config USE_AUDIO_DEBUGGER
        bool "Enable Audio Debugging"
        default n

    config AUDIO_DEBUG_UDP_SERVER
        string "UDP Server for Audio Debugging"
        default "192.168.1.100"
        depends on USE_AUDIO_DEBUGGER

    config OTA_URL
        string "OTA Server URL"
        default "http://localhost/ota"

endmenu
```
